## drivers/sensor/Kconfig
```kconfig
# Copyright (c) 2024 CATIE
# SPDX-License-Identifier: Apache-2.0

if SENSOR

rsource "htu21d/Kconfig"

endif # SENSOR
```

## drivers/sensor/te-connectivity/Kconfig
```kconfig
# Copyright (c) 2024 CATIE
# SPDX-License-Identifier: Apache-2.0

rsource "htu21d/Kconfig"
```

## drivers/sensor/te-connectivity/htu21d/Kconfig
```kconfig
# HTU21D humidity and temperature sensor configuration options

# Copyright (c) 2024 CATIE
# SPDX-License-Identifier: Apache-2.0

config HTU21D
    bool "HTU21D humidity and temperature sensor"
    default y
    depends on DT_HAS_TE_CONNECTIVITY_HTU21D_ENABLED
    select I2C
    select CRC
    help
      Enable driver for TE Connectivity HTU21D humidity and temperature sensor.
```

## dts/bindings/sensor/te-connectivity,htu21d.yaml
```yaml
# Copyright (c) 2024 CATIE
# SPDX-License-Identifier: Apache-2.0

description: |
    TE Connectivity humidity and temperature sensor

compatible: "te-connectivity,htu21d"

include: [sensor-device.yaml, i2c-device.yaml]
```

## samples/sample.yaml
```yaml
sample:
  name: HTU21D(F) RH/T sensor sample
tests:
  sample.default:
    tags: sensor
    integration_platforms:
      - zest_core_stm32l4a6rg
    depends_on: i2c
```
