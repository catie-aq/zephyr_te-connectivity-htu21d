/*
 * Copyright (c) 2024 CATIE
 *
 * SPDX-License-Identifier: Apache-2.0
 */

&sixtron_i2c {
	status = "okay";

	htu21d@40 {
		compatible = "te-connectivity,htu21d";
		status = "okay";
		reg = <0x40>;
	};
};
